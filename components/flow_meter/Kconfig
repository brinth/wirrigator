## components/flow_meter/Kconfig
```kconfig
config CONFIG_FLOWMETER_ENABLE
	bool "COMP_FLOW_METER"
	help
		This enables the Flow Meter to be used for validating Valve operation
```

## components/mqtt_client/KConfig
```kconfig
config CONFIG_MQTT_CLIENT
	bool "COMP_MQTT_CLIENT"
	help
		This enables the MQTT client for connecting to broker
```

## components/open_hab/Kconfig
```kconfig
config CONFIG_OPENHAB_ENABLE
	bool "COMP_OPENHAB"
	help
		This enables Open HAB Communication through MQTT Protocol
```
